## drivers/modem/Kconfig.ec20
```kconfig
# quectel ec20 driver options

# Copyright (c) 2019 Foundries.io
# SPDX-License-Identifier: Apache-2.0

config MODEM_EC20
	bool "Enable ec20 4G modem driver"
	select MODEM_CONTEXT
	select MODEM_CMD_HANDLER
	select MODEM_IFACE_UART
	select MODEM_SOCKET
	select NET_OFFLOAD
	select NET_SOCKETS_OFFLOAD
	imply GPIO
	help
	  Choose this setting to enable ec20 4G modem
	  driver.

if MODEM_EC20

config MODEM_EC20_RX_STACK_SIZE
	int "Stack size for the ec20 modem driver RX thread"
	default 1028
	help
	  This stack is used by the ec20 RX thread.

config MODEM_EC20_RX_WORKQ_STACK_SIZE
	int "Stack size for the ec20 modem driver work queue"
	default 2048
	help
	  This stack is used by the work queue to pass off net_pkt data
	  to the rest of the network stack, letting the rx thread continue
	  processing data.

config MODEM_EC20_APN
	string "APN for establishing network connection"
	default "hologram"
	help
	  This setting is used in the AT+CGDCONT command to set the APN name
	  for the network connection context.  This value is specific to
	  the network provider and may need to be changed.

config MODEM_EC20_MANUAL_MCCMNO
	string "MCC/MNOfor establishing network connection"
	help
	  This setting is used in the AT+COPS command to set the MCC/MNO
	  for the network connection context.  This value is specific to
	  the network provider and may need to be changed if auto is not
	  selected.

config MODEM_EC20_INIT_PRIORITY
	int "ec20 driver init priority"
	default 80
	help
	  ec20 device driver initialization priority.
	  Do not mess with it unless you know what you are doing.
	  Note that the priority needs to be lower than the net stack
	  so that it can start before the networking sub-system.

endif # MODEM_EC20
```

## dts/bindings/modem/quectel,ec20.yaml
```yaml
# Copyright (c) 2019, Foundries.io
# SPDX-License-Identifier: Apache-2.0

title: Quectel EC20 modem

description: >
    This is a representation of the EC20 modem.

compatible: "quectel,ec20"

include: uart-device.yaml

properties:
    label:
      required: true

    mdm-power-gpios:
      type: phandle-array
      required: true

    mdm-reset-gpios:
      type: phandle-array
      required: true
```
